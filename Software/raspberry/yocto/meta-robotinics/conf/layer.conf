## Software/raspberry/yocto/meta-robotinics/conf/layer.conf
```bitbake
BBPATH .= ":${LAYERDIR}"

BBFILES += "${LAYERDIR}/recipes-*/*/*.bb ${LAYERDIR}/recipes-*/*/*.bbappend"

BBFILE_COLLECTIONS += "robotinics"
BBFILE_PATTERN_robotinics = "^${LAYERDIR}/"
BBFILE_PRIORITY_robotinics = "8"

LAYERSERIES_COMPAT_robotinics = "wrynose"
```
